## drivers/Kconfig
```kconfig
# Copyright (c) 2021 Nordic Semiconductor ASA
# SPDX-License-Identifier: Apache-2.0

menu "Drivers"
rsource "nrf_sw_servo/Kconfig"
endmenu
```

## drivers/servo/Kconfig
```kconfig
# Servo implementation that uses NRFX PWM driver
#
# Copyright (c) 2021 Daniel Veilleux
#
# SPDX-License-Identifier: LicenseRef-BSD-5-Clause-Nordic
#

menuconfig NRF_SW_SERVO
	bool "Servo implementation that uses NRFX PWM driver"
	select NRFX_PWM
	help
	  Enable nRF SW servo driver

if NRF_SW_SERVO

config NRF_SW_SERVO_ALLOW_PWM0
	bool "Allow PWM0"
	default y
    select NRFX_PWM0
	help
		Allow the driver to use PWM peripheral instance 0

config NRF_SW_SERVO_ALLOW_PWM1
	bool "Allow PWM1"
	default y
    select NRFX_PWM1
	help
		Allow the driver to use PWM peripheral instance 1

config NRF_SW_SERVO_ALLOW_PWM2
	bool "Allow PWM2"
	default y
    select NRFX_PWM2
	help
		Allow the driver to use PWM peripheral instance 2

config NRF_SW_SERVO_ALLOW_PWM3
	bool "Allow PWM3"
	default y
    select NRFX_PWM3
    depends on HAS_HW_NRF_PWM3
	help
		Allow the driver to use PWM peripheral instance 3

config NRF_SW_SERVO_INIT_PRIORITY
	int "Servo init priority"
	default 90
	help
	  Servo initialization priority

module = NRF_SW_SERVO
module-str = NRF-SW-SERVO
source "${ZEPHYR_BASE}/subsys/logging/Kconfig.template.log_config"

endif #NRF_SW_SERVO
```

## dts/bindings/nrf_sw_servo/nrf_sw_servo.yaml
```yaml
# Copyright (c) 2021 Daniel Veilleux
# SPDX-License-Identifier: LicenseRef-BSD-5-Clause-Nordic

description: Servo implementation that uses NRFX PWM driver

compatible: "nrf-sw-servo"

include: base.yaml

properties:
  status:
    required: true
    type: string
    description: Human readable string describing the device's status

  pin:
    type: int
    description: Output pin, using NRFX-compatible index
    required: true

  init_value:
    type: int
    description: Initial value [0, 100]
    required: true

  min_pulse_us:
    type: int
    description: Minimum pulse width in microseconds [0, 1500]
    required: true

  max_pulse_us:
    type: int
    description: Maximum pulse width in microseconds [1500, 3000]
    required: true
```

## west.yml
```yaml
# Copyright (c) 2021 Nordic Semiconductor ASA
# SPDX-License-Identifier: Apache-2.0

manifest:
  remotes:
    - name: ncs
      url-base: https://github.com/nrfconnect

  projects:
    - name: nrf
      remote: ncs
      repo-path: sdk-nrf
      revision: v2.4.0
      import: true

  self:
    path: nrf_servo
```
