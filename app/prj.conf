## CMakeLists.txt
```
# Copyright (c) 2021 Nordic Semiconductor ASA
# SPDX-License-Identifier: Apache-2.0

cmake_minimum_required(VERSION 3.13.1)
find_package(Zephyr REQUIRED HINTS $ENV{ZEPHYR_BASE})

project(app LANGUAGES C VERSION 0.1.0)

configure_file(app_version.h.in ${CMAKE_BINARY_DIR}/app/include/app_version.h)
target_include_directories(app PRIVATE ${CMAKE_BINARY_DIR}/app/include src include)

FILE(GLOB app_sources src/*.c)
target_sources(app PRIVATE ${app_sources})
```

## Kconfig
```
# Copyright (c) 2021 Nordic Semiconductor ASA
# SPDX-License-Identifier: Apache-2.0

menu "Zephyr"
source "Kconfig.zephyr"
endmenu

module = APP
module-str = APP
source "subsys/logging/Kconfig.template.log_config"
```

## prj.conf
```kconfig
# Copyright (c) 2021 Nordic Semiconductor ASA
# SPDX-License-Identifier: Apache-2.0

CONFIG_NRF_SERVO=y
```

## rtt.conf
```kconfig
# Copyright (c) 2021 Nordic Semiconductor ASA
# SPDX-License-Identifier: Apache-2.0
#
# This is a Kconfig fragment which can be used to enable Segger RTT options.
# It should be used in conjunction with debug.conf.

# segger RTT console
CONFIG_USE_SEGGER_RTT=y
CONFIG_RTT_CONSOLE=y
```

## boards/nrf52dk_nrf52832.overlay
```dts
/ {
    servo0: nrf-servo0 {
        compatible = "nrf-servo";
        pin = <27>;
        init_value = <50>;
        min_pulse_us = <1000>;
        max_pulse_us = <2000>;
        status = "okay";
    };
};
```

## src/main.c
```c
/*
 * Copyright (c) 2021 Nordic Semiconductor ASA
 * SPDX-License-Identifier: Apache-2.0
 */

#include <stdint.h>
#include <zephyr/kernel.h>

#include "drivers/nrf_servo.h"

#include <zephyr/logging/log.h>
LOG_MODULE_REGISTER(main, CONFIG_APP_LOG_LEVEL);

void main(void)
{
    const struct device *servo = DEVICE_DT_GET(DT_NODELABEL(servo0));
    if (servo == NULL) {
        printk("Failed to get servo dev binding\n");
        return;
    }

    if (!device_is_ready(servo)) {
    	printk("servo device is not ready\n");
        return;
    }

    int ret = servo_write(servo, 100);
    if (!ret) {
        printk("servo_write failed: %d\n", ret);
        return;
    }
}
```
